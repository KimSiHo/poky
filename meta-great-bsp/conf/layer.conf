## meta-great-bsp/conf/layer.conf
```bitbake
BBPATH  =. "${LAYERDIR}:"
BBFILES += "\
    ${LAYERDIR}/recipes*/*/*.bb \
    ${LAYERDIR}/recipes*/*/*.bbappend \
    ${LAYERDIR}/append/*.bbappend \
    ${LAYERDIR}/recipes*/*.bb \
"
BBFILE_COLLECTIONS += "greatbsp"
BBFILE_PATTERN_greatbsp = "^${LAYERDIR}/"
BBFILE_PRIORITY_greatbsp = "6"
LAYERSERIES_COMPAT_greatbsp = "${LAYERSERIES_COMPAT_core}"
```
